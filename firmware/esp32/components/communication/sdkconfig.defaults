## firmware/esp32/components/communication/sdkconfig.defaults
```kconfig
# ESP-IDF 项目配置
CONFIG_ESP_WIFI_AUTH_OPEN=y
CONFIG_ESP_WIFI_AUTH_WEP=y
CONFIG_ESP_WIFI_AUTH_WPA_PSK=y
CONFIG_ESP_WIFI_AUTH_WPA2_PSK=y
CONFIG_ESP_WIFI_AUTH_WPA3_SAE=y

CONFIG_ESPTOOLPY_FLASHSIZE="4MB"
CONFIG_ESPTOOLPY_FLASHSIZE_4MB=y
```
